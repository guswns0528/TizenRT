## apps/examples/cid2_sample/Kconfig
```kconfig
#
# For a description of the syntax of this configuration file,
# see kconfig-language at https://www.kernel.org/doc/Documentation/kbuild/kconfig-language.txt
#

config EXAMPLES_CID2_SAMPLE
	bool "Creative Integrated Design 2, group C sample"
	default n
	---help---
		Enable the Creative Integrated Design 2, group C sample

if EXAMPLES_CID2_SAMPLE

config EXAMPLES_CID2_SAMPLE_PROGNAME
	string "Program name"
	default "cid2_sample"
	depends on BUILD_KERNEL
	---help---
		This is the name of the program that will be use when the NSH ELF
		program is installed.

endif

config USER_ENTRYPOINT
	string
	default "cid2_sample_main" if ENTRY_CID2_SAMPLE
```

## os/arch/arm/src/stm32f4/Kconfig
```kconfig
#
# For a description of the syntax of this configuration file,
# see kconfig-language at https://www.kernel.org/doc/Documentation/kbuild/kconfig-language.txt
#

comment "ST Micro STM32F4xx Chip Configuration Options"

choice
	prompt "ST Micro Chip Selection"
	default ARCH_CHIP_STM32F427

config ARCH_CHIP_STM32F427
	bool "STM32F4 "
	depends on ARCH_CHIP_STM32F4
	select STM32_STM32F427
	select ARCH_CORTEXM4
	select ARMV7M_ICACHE
	select ARMV7M_DCACHE

endchoice

config STM32_STM32F427
	bool
	default y
	select STM32_HAVE_USART1
	select STM32_HAVE_USART2
	select STM32_HAVE_USART3
	select STM32_HAVE_UART4
	select STM32_HAVE_UART5
	select STM32_HAVE_USART6
	select STM32_HAVE_UART7
	select STM32_HAVE_UART8

menu "STM32F4 Peripheral Support"

config SERIAL_TERMIOS
	bool
	default y

config ARCH_HAVE_SERIAL_TERMIOS
	bool
	default y

config STM32_HAVE_USART1
	bool
	default n

config STM32_HAVE_USART2
	bool
	default n

config STM32_HAVE_USART3
	bool
	default n

config STM32_HAVE_UART4
	bool
	default n

config STM32_HAVE_UART5
	bool
	default n

config STM32_HAVE_USART6
	bool
	default n

config STM32_HAVE_UART7
	bool
	default n

config STM32_HAVE_UART8
	bool
	default n


config STM32_USART1
	bool "USART1"
	default n
    depends on STM32_HAVE_USART1
	select ARCH_HAVE_USART1
	select USART1_SERIAL_TERMIOS

config STM32_USART2
	bool "USART2"
	default n
    depends on STM32_HAVE_USART2
	select ARCH_HAVE_USART2
	select USART2_SERIAL_TERMIOS

config STM32_USART3
	bool "UART3"
	default n
    depends on STM32_HAVE_USART3
	select ARCH_HAVE_USART3
	select USART3_SERIAL_TERMIOS

config STM32_UART4
	bool "UART4"
	default n
    depends on STM32_HAVE_UART4
	select ARCH_HAVE_UART4
	select UART4_SERIAL_TERMIOS

config STM32_UART5
	bool "UART5"
	default n
    depends on STM32_HAVE_UART5
	select ARCH_HAVE_UART5
	select UART5_SERIAL_TERMIOS

config STM32_USART6
	bool "USART6"
	default n
    depends on STM32_HAVE_USART6
	select ARCH_HAVE_USART6
	select USART6_SERIAL_TERMIOS

config STM32_UART7
	bool "UART6"
	default n
    depends on STM32_HAVE_UART7
	select ARCH_HAVE_UART7
	select UART7_SERIAL_TERMIOS

config STM32_UART8
	bool "UART8"
	default n
    depends on STM32_HAVE_UART8
	select ARCH_HAVE_UART8
	select UART8_SERIAL_TERMIOS

endmenu
```
